/dts-v1/;
// magic:		0xd00dfeed
// totalsize:		0x395 (917)
// off_dt_struct:	0x38
// off_dt_strings:	0x338
// off_mem_rsvmap:	0x28
// version:		17
// last_comp_version:	16
// boot_cpuid_phys:	0x0
// size_dt_strings:	0x5d
// size_dt_struct:	0x300

/include/ "config_base.dtsi"
