/dts-v1/;
// magic:		0xd00dfeed
// totalsize:		0x3cb (971)
// off_dt_struct:	0x38
// off_dt_strings:	0x360
// off_mem_rsvmap:	0x28
// version:		17
// last_comp_version:	16
// boot_cpuid_phys:	0x0
// size_dt_strings:	0x6b
// size_dt_struct:	0x328

/include/ "config_base.dtsi"

&models {
    reef {
        wallpaper = "simon";
        firmware {
            main-rw-image = "bcs://Reef.9000.0.0.tbz2";
        };
    };
};
